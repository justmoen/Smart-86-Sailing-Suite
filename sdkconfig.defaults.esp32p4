## sdkconfig.defaults.esp32p4
```kconfig
# ============================================================
# ESP32-P4 + ESP32-C6 ESP-Hosted / SDIO
# ============================================================

# ESP-Hosted memory placement
CONFIG_ESP_HOSTED_MEMPOOL_PREFER_SPIRAM=y
CONFIG_ESP_HOSTED_DFLT_TASK_FROM_SPIRAM=y

# Required for ESP-Hosted PSRAM transport buffers on ESP32-P4.
# 1600-byte transport buffers are not compatible with 128-byte
# L2 cache-line alignment.
CONFIG_CACHE_L2_CACHE_LINE_64B=y


# ============================================================
# Wi-Fi Remote performance
# ============================================================

CONFIG_WIFI_RMT_STATIC_RX_BUFFER_NUM=16
CONFIG_WIFI_RMT_DYNAMIC_RX_BUFFER_NUM=64
CONFIG_WIFI_RMT_DYNAMIC_TX_BUFFER_NUM=64

CONFIG_WIFI_RMT_AMPDU_TX_ENABLED=y
CONFIG_WIFI_RMT_TX_BA_WIN=32

CONFIG_WIFI_RMT_AMPDU_RX_ENABLED=y
CONFIG_WIFI_RMT_RX_BA_WIN=32


# ============================================================
# LWIP TCP/IP performance
# ============================================================

CONFIG_LWIP_TCP_SND_BUF_DEFAULT=65534
CONFIG_LWIP_TCP_WND_DEFAULT=65534

CONFIG_LWIP_TCP_RECVMBOX_SIZE=64
CONFIG_LWIP_UDP_RECVMBOX_SIZE=64
CONFIG_LWIP_TCPIP_RECVMBOX_SIZE=64

CONFIG_LWIP_TCP_SACK_OUT=y
```
